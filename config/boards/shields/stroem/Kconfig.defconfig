## config/boards/shields/stroem/Kconfig.defconfig
```kconfig
if SHIELD_STROEM_LEFT || SHIELD_STROEM_RIGHT

config SHIELD_NAME
    string
    default "stroem"

endif
```

## config/boards/shields/stroem/Kconfig.shield
```kconfig
config SHIELD_STROEM_LEFT
    def_bool $(shields_list_contains,stroem_left)

config SHIELD_STROEM_RIGHT
    def_bool $(shields_list_contains,stroem_right)
```

## config/west.yml
```yaml
manifest:
  remotes:
    - name: zmkfirmware
      url: https://github.com
  projects:
    - name: zmk
      remote: zmkfirmware
      revision: main
  self:
    path: config
```
